## sdkconfig.defaults
```kconfig
CONFIG_DEFAULT_HUMAN_FACE_DETECT_MODEL=0
CONFIG_FLASH_HUMAN_FACE_DETECT_MSRMNP_S8_V1=y
CONFIG_HUMAN_FACE_DETECT_MODEL_IN_FLASH_PARTITION=y
CONFIG_HUMAN_FACE_DETECT_MODEL_LOCATION=1

CONFIG_DEFAULT_HUMAN_FACE_FEAT_MODEL=0
CONFIG_FLASH_HUMAN_FACE_FEAT_MFN_S8_V1=y
CONFIG_HUMAN_FACE_FEAT_MODEL_IN_FLASH_PARTITION=y
CONFIG_HUMAN_FACE_FEAT_MODEL_LOCATION=1
```
